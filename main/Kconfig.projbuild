## main/Kconfig.projbuild
```kconfig
menu "Project configuration"

    menu "SPI2 PINS"
        config PRJ_PIN_SPI2_MISO
            int "PIN_SPI2_MISO"
            range -1 60
            default 13

        config PRJ_PIN_SPI2_MOSI
            int "PIN_SPI2_MOSI"
            range -1 60
            default 11

        config PRJ_PIN_SPI2_SCK
            int "PIN_SPI2_SCK"
            range -1 60
            default 12
    endmenu

    menu "Ili9341 display"
        config PRJ_PIN_ILI9341_RES
            int "PIN_RES"
            range -1 60
            default 6

        config PRJ_PIN_ILI9341_DC
            int "PIN_DC"
            range -1 60
            default 7

        config PRJ_PIN_ILI9341_BK_LIGHT
            int "PIN_BK_LIGHT"
            range -1 60
            default 21

        config PRJ_PIN_ILI9341_CS
            int "PIN_CS"
            range -1 60
            default 10
    endmenu

    menu "xpt2046 touch"
        config TOUCH_CS_PIN
            int "TOUCH_CS_PIN"
            range -1 60
            default -1

        config TOUCH_IRQ_PIN
            int "TOUCH_IRQ_PIN"
            range -1 60
            default -1

        config TOUCH_RESET_PIN
            int "TOUCH_RESET_PIN"
            range -1 60
            default -1

        choice TOUCH_SPI_HOST
            prompt "TOUCH_SPI_HOST"
            default TOUCH_SPI2_HOST

            config TOUCH_SPI2_HOST
                bool "SPI 2"

            config TOUCH_SPI3_HOST
                bool "SPI 3"
        endchoice
    endmenu

endmenu
```
